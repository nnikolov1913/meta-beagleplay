## conf/layer.conf
```bitbake
# We have a conf and classes directory, add to BBPATH
BBPATH .= ":${LAYERDIR}"

# We have recipes-* directories, add to BBFILES
BBFILES += "${LAYERDIR}/recipes-*/*/*.bb \
            ${LAYERDIR}/recipes-*/*/*.bbappend"

BBFILE_COLLECTIONS += "meta-beagleplay"
BBFILE_PATTERN_meta-beagleplay = "^${LAYERDIR}/"
BBFILE_PRIORITY_meta-beagleplay = "6"

LAYERDEPENDS_meta-beagleplay = "core"
LAYERSERIES_COMPAT_meta-beagleplay = "kirkstone"
```
